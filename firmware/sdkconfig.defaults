## firmware/sdkconfig.defaults
```kconfig
# Target: ESP32-S3
CONFIG_IDF_TARGET="esp32s3"

# Flash: 16MB octal SPI
CONFIG_ESPTOOLPY_FLASHSIZE_16MB=y
CONFIG_ESPTOOLPY_FLASHMODE_QIO=y

# PSRAM: 8MB octal
CONFIG_ESP32S3_SPIRAM_SUPPORT=y
CONFIG_SPIRAM_MODE_OCT=y
CONFIG_SPIRAM_SPEED_80M=y

# Partition table: custom (dual OTA)
CONFIG_PARTITION_TABLE_CUSTOM=y
CONFIG_PARTITION_TABLE_CUSTOM_FILENAME="partitions.csv"

# FreeRTOS
CONFIG_FREERTOS_HZ=1000
CONFIG_FREERTOS_TIMER_TASK_STACK_DEPTH=4096

# WiFi
CONFIG_ESP_WIFI_SOFTAP_SUPPORT=y
CONFIG_ESP_WIFI_NAN_ENABLE=n

# Bluetooth (BLE for provisioning)
CONFIG_BT_ENABLED=y
CONFIG_BT_NIMBLE_ENABLED=y

# MQTT
CONFIG_MQTT_PROTOCOL_5=y

# Power management
CONFIG_PM_ENABLE=y

# Watchdog: 30 second timeout
CONFIG_ESP_TASK_WDT_TIMEOUT_S=30

# Logging
CONFIG_LOG_DEFAULT_LEVEL_INFO=y
```
